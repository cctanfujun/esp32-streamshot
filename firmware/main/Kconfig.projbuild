## firmware/main/Kconfig.projbuild
```kconfig
menu "StreamShot serial input"
choice STREAMSHOT_SERIAL_TRANSPORT
    prompt "Command transport (never Wi-Fi)"
    default STREAMSHOT_USB_SERIAL
config STREAMSHOT_USB_SERIAL
    bool "ESP32-S3 native USB Serial/JTAG"
config STREAMSHOT_UART_SERIAL
    bool "UART0 through the board's USB-UART bridge (115200 baud)"
endchoice
endmenu
```

## firmware/sdkconfig.defaults
```kconfig
CONFIG_IDF_TARGET="esp32s3"
CONFIG_BT_ENABLED=y
CONFIG_BT_BLUEDROID_ENABLED=y
CONFIG_BT_BLE_ENABLED=y
CONFIG_BT_BLE_42_FEATURES_SUPPORTED=y
CONFIG_BT_CLASSIC_ENABLED=n
CONFIG_PARTITION_TABLE_SINGLE_APP_LARGE=y
CONFIG_ESP_CONSOLE_NONE=y
CONFIG_LOG_DEFAULT_LEVEL_NONE=y
CONFIG_LOG_MAXIMUM_LEVEL=0
CONFIG_BOOTLOADER_LOG_LEVEL_NONE=y
CONFIG_COMPILER_OPTIMIZATION_SIZE=y
CONFIG_ESP_SYSTEM_PANIC_SILENT_REBOOT=y
CONFIG_ESP_MAIN_TASK_STACK_SIZE=8192
CONFIG_STREAMSHOT_USB_SERIAL=y
```
